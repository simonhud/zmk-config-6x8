#include "6x8_trackball.dtsi"
#include <zephyr/dt-bindings/input/input-event-codes.h>

/ {
    chosen {
        zmk,kscan = &kscan;
        zmk,matrix-transform = &default_transform;
    };

    kscan: kscan {
        compatible = "zmk,kscan-gpio-matrix";
        diode-direction = "col2row";
        wakeup-source;

        row-gpios
            = <&pro_micro 4 (GPIO_ACTIVE_HIGH | GPIO_PULL_DOWN)>
            , <&pro_micro 5 (GPIO_ACTIVE_HIGH | GPIO_PULL_DOWN)>
            , <&pro_micro 6 (GPIO_ACTIVE_HIGH | GPIO_PULL_DOWN)>
            , <&pro_micro 7 (GPIO_ACTIVE_HIGH | GPIO_PULL_DOWN)>
            , <&pro_micro 8 (GPIO_ACTIVE_HIGH | GPIO_PULL_DOWN)>
            , <&pro_micro 9 (GPIO_ACTIVE_HIGH | GPIO_PULL_DOWN)>
            ;

        col-gpios
            = <&pro_micro 21 GPIO_ACTIVE_HIGH>
            , <&pro_micro 20 GPIO_ACTIVE_HIGH>
            , <&pro_micro 19 GPIO_ACTIVE_HIGH>
            , <&pro_micro 18 GPIO_ACTIVE_HIGH>
            , <&pro_micro 15 GPIO_ACTIVE_HIGH>
            , <&pro_micro 14 GPIO_ACTIVE_HIGH>
            , <&pro_micro 16 GPIO_ACTIVE_HIGH>
            , <&pro_micro 10 GPIO_ACTIVE_HIGH>
            ;
    };
};
// Offset of 8 because the left side has 8 columns
/ { &default_transform {
    col-offset = <8>;
    };
};
/ {
    trackball_listener {
        status = "okay";
        compatible = "zmk,input-listener";
        device = <&trackball>;
    };
};
/ &pinctrl {
    spi0_default: spi0_default {
        group1 {
            psels = <NRF_PSEL(SPIM_MOSI, 0, 8)>,     // Set P0.08 (D0) as MOSI or SDIO
                    <NRF_PSEL(SPIM_MISO, 0, 8)>,     // Set P0.08 (D0) as MISO
                    <NRF_PSEL(SPIM_SCK, 0, 17)>;     // Set P0.17 (D2) as SCK or SCLK
        };
    };
    
    spi0_sleep: spi0_sleep {
        group1 {
            psels = <NRF_PSEL(SPIM_MOSI, 0, 8)>,     // Set P0.20 (D0) as MOSI or SDIO
                    <NRF_PSEL(SPIM_MISO, 0, 8)>,     // Set P0.20 (D0) as MISO
                    <NRF_PSEL(SPIM_SCK, 0, 17)>;     // Set P0.17 (D2) as SCK or SCLK
            low-power-enable;
        };
    };
};

&spi0 {
    status = "okay";
    compatible = "nordic,nrf-spim";
    pinctrl-0 = <&spi0_default>;
    pinctrl-1 = <&spi0_sleep>;
    pinctrl-names = "default", "sleep";
    cs-gpios = <&gpio0 1 GPIO_ACTIVE_LOW>;             // NCS D1 (P0.06)

    trackball: trackball@0 {
        status = "okay";
        compatible = "pixart,pmw3610";
        reg = <0>;
        spi-max-frequency = <2000000>;
        irq-gpios = <&gpio0 3 (GPIO_ACTIVE_LOW | GPIO_PULL_UP)>; // MOT D3 (P0.20)
    };
};

//        cpi = <3200>;  - removed these lines frome the above code in the trackball.
//        evt-type = <INPUT_EV_REL>;
//        x-input-code = <INPUT_REL_X>;
//        y-input-code = <INPUT_REL_Y>;
