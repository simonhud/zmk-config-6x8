## config/boards/shields/Kconfig.defconfig
```kconfig
if SHIELD_6X8_TRACKBALL_LEFT # changed this from SHIELD_MY_KEYBOARD_LEFT

# Name must be less than 16 characters long!
config ZMK_KEYBOARD_NAME
    default "6x8_Trackball"

config ZMK_SPLIT_ROLE_CENTRAL
    default y

endif

if SHIELD_6X8_TRACKBALL_LEFT || SHIELD_6X8_TRACKBALL_RIGHT

config ZMK_SPLIT
    default y

endif
```
